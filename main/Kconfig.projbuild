## main/Kconfig.projbuild
```kconfig
menu "Clock configuration"

    config CLOCK_WIFI_SSID
        string "Wi-Fi SSID"
        default ""
        help
            Optional initial 2.4 GHz Wi-Fi network. If empty or unavailable,
            the clock opens the Connecting the clock to Wi-Fi setup network. Settings saved
            from the phone are stored in NVS and take precedence.

    config CLOCK_WIFI_PASSWORD
        string "Wi-Fi password"
        default ""
        help
            Optional initial Wi-Fi password. Leave empty for an open network
            or to configure the clock later from a phone. Runtime credentials
            are stored in NVS; no password is added to the source code.

    config CLOCK_WIFI_STATIC_IP
        bool "Use a static station IP address"
        default y
        help
            Keeps the control panel address unchanged. The default values are
            intended for a 192.168.1.0/24 network. Choose an unused address
            outside the router DHCP pool or reserve it in the router.

    config CLOCK_WIFI_STATIC_IP_ADDRESS
        string "Static station IP address"
        depends on CLOCK_WIFI_STATIC_IP
        default "192.168.1.51"

    config CLOCK_WIFI_STATIC_GATEWAY
        string "Static IP gateway"
        depends on CLOCK_WIFI_STATIC_IP
        default "192.168.1.1"

    config CLOCK_WIFI_STATIC_NETMASK
        string "Static IP netmask"
        depends on CLOCK_WIFI_STATIC_IP
        default "255.255.255.0"

    config CLOCK_WIFI_STATIC_DNS
        string "Static IP DNS server"
        depends on CLOCK_WIFI_STATIC_IP
        default "192.168.1.1"

    config CLOCK_NTP_SERVER
        string "NTP server"
        default "pool.ntp.org"
        help
            Host name of the server used to synchronize the clock.

    config CLOCK_TIMEZONE
        string "POSIX timezone"
        default "MSK-3"
        help
            POSIX TZ value. MSK-3 means UTC+3 without daylight saving time.
            Other examples: UTC0, EET-2EEST,M3.5.0/3,M10.5.0/4.

    config CLOCK_LCD_SPI_CLOCK_HZ
        int "Display SPI clock (Hz)"
        default 40000000
        range 1000000 80000000
        help
            Reduce this value to 10000000 or 20000000 if a long or unreliable
            cable causes display artifacts.

    config CLOCK_LCD_BUFFER_LINES
        int "LVGL buffer height (lines)"
        default 20
        range 10 76
        help
            Two DMA buffers are allocated. Larger buffers can render faster but
            use more RAM: 284 * lines * 2 bytes per buffer.

endmenu
```

## sdkconfig.defaults
```kconfig
CONFIG_PARTITION_TABLE_CUSTOM=y
CONFIG_PARTITION_TABLE_CUSTOM_FILENAME="partitions.csv"
CONFIG_LV_MEM_SIZE=65536
# CONFIG_ESP_TASK_WDT_CHECK_IDLE_TASK_CPU0 is not set
CONFIG_CLOCK_WIFI_STATIC_IP=y
CONFIG_CLOCK_WIFI_STATIC_IP_ADDRESS="192.168.1.51"
CONFIG_CLOCK_WIFI_STATIC_GATEWAY="192.168.1.1"
CONFIG_CLOCK_WIFI_STATIC_NETMASK="255.255.255.0"
CONFIG_CLOCK_WIFI_STATIC_DNS="192.168.1.1"
```
